ENTRY(_start)

SECTIONS {
    . = 10M;

    .text :
    {
        *(.text)
    }

    .rodata :
    {
        *(.rodata)
    }

    .data :
    {
        *(.data)
    }

    .bss :
    {
        *(.bss COMMON)
    }
}
